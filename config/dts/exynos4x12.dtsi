	gpu@13000000 {
	              compatible = "samsung,exynos4x12-g3d";
	              reg = <0x13001000 0x200>,
	                    <0x13000000 0x100>, <0x13003000 0x100>,
	                    <0x13008000 0x1100>, <0x13004000 0x100>,
	                    <0x1300a000 0x1100>, <0x13005000 0x100>,
	                    <0x1300c000 0x1100>, <0x13006000 0x100>,
	                    <0x1300e000 0x1100>, <0x13007000 0x100>;
	              interrupts = <0 127 0>, <0 122 0>, <0 123 0>, <0 118 0>,
	                           <0 124 0>, <0 119 0>, <0 125 0>, <0 120 0>,
	                           <0 126 0>, <0 121 0>;
	              clock-names = "sclk_vpll", "mout_g3d1", "mout_g3d", "sclk_g3d";
	              clocks = <&clock 11>, <&clock 393>, <&clock 394>, <&clock 172>;
	              samsung,power-domain = <&pd_g3d>;
	              status = "disabled";
	};
